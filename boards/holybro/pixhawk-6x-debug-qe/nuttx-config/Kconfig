## src/drivers/quad_encoder/Kconfig
```kconfig
menuconfig DRIVERS_QUAD_ENCODER
	bool "Quadrature Encoder Driver"
	default n
	---help---
		Enable support for GPIO-based quadrature encoders.
		This driver interfaces with the NuttX GPIO quadrature encoder
		framework to provide encoder data for rotary applications including
		wheels, motors, and position sensors.

		Features:
		- Supports up to 4 encoders per instance
		- Multi-instance support (up to 4 instances)
		- Independent parameter configuration per encoder
		- Configurable pulses per revolution and direction inversion
		- Auto-detection of available encoders
```

## src/drivers/quad_encoder_gpio/Kconfig
```kconfig
menu "Quad Encoder GPIO"
	menuconfig DRIVERS_QUAD_ENCODER_GPIO
		bool "GPIO-based Quadrature Encoder Driver"
		default n
		depends on BOARD_HAS_QENCODER_GPIO
		---help---
			Enable support for GPIO interrupt-based quadrature encoder driver.

			This driver uses GPIO interrupts to decode quadrature encoder signals
			without relying on NuttX timer drivers. It provides direct hardware
			access for STM32H7 and avoids syslog issues.

			The driver supports multiple encoder instances and can be configured
			per board using board-specific configuration files.
```

## src/drivers/quadrature_encoder/Kconfig
```kconfig
menu "Quadrature Encoder"
	menuconfig DRIVERS_QUADRATURE_ENCODER
		bool "Quadrature Encoder Driver"
		default n
		---help---
			Enable support for GPIO interrupt-based quadrature encoder driver.

			This high-performance driver reads quadrature encoders without
			requiring hardware timer peripherals, making it suitable for
			applications where timer resources are limited.

			Features:
			- Multi-instance support (up to 4 encoders)
			- Digital filtering for noise immunity
			- Real-time velocity calculation
			- Comprehensive error detection
			- Thread-safe operation

endmenu
```

## src/modules/chassis_control/Kconfig
```kconfig
menuconfig MODULES_CHASSIS_CONTROL
	bool "chassis_control"
	default n
	---help---
		Enable support for chassis_control
```

## src/modules/load_analysis/Kconfig
```kconfig
menuconfig MODULES_LOAD_ANALYSIS
	bool "load_analysis"
	default n
	---help---
		Enable support for motor load analysis and lamp control coordination.
		This module analyzes HBridge motor loads across all instances and
		generates lamp control commands for distributed systems.
```

## src/modules/trajectory_followers/bucket_trajectory_follower/Kconfig
```kconfig
menuconfig MODULES_BUCKET_TRAJECTORY_FOLLOWER
	bool "bucket_trajectory_follower"
	default y
	depends on MODULES_TRAJECTORY_FOLLOWERS
	---help---
		Enable the bucket trajectory follower module.

		This module implements 6-DOF PID control for bucket motion control.
		It provides trajectory following capabilities for the wheel loader bucket assembly,
		including:
		- 6-DOF PID controllers (position + orientation)
		- Joint limit enforcement
		- Gravity compensation
		- Load handling compensation
		- Safety constraint monitoring

if MODULES_BUCKET_TRAJECTORY_FOLLOWER

config BUCKET_TRAJECTORY_FOLLOWER_UPDATE_RATE
	int "Controller update rate (Hz)"
	default 50
	range 20 100
	---help---
		Update frequency of the bucket trajectory follower in Hz.
		Higher rates provide better tracking but increase CPU usage.

config BUCKET_TRAJECTORY_FOLLOWER_PID_P_GAIN
	int "Position PID proportional gain (* 100)"
	default 500
	range 100 2000
	---help---
		Proportional gain for position PID controllers (value * 0.01).
		Higher values provide faster response but may cause oscillations.

config BUCKET_TRAJECTORY_FOLLOWER_PID_I_GAIN
	int "Position PID integral gain (* 1000)"
	default 100
	range 0 500
	---help---
		Integral gain for position PID controllers (value * 0.001).
		Helps eliminate steady-state errors.

config BUCKET_TRAJECTORY_FOLLOWER_PID_D_GAIN
	int "Position PID derivative gain (* 1000)"
	default 50
	range 0 200
	---help---
		Derivative gain for position PID controllers (value * 0.001).
		Provides damping and improves stability.

config BUCKET_TRAJECTORY_FOLLOWER_ORIENTATION_P_GAIN
	int "Orientation PID proportional gain (* 100)"
	default 300
	range 50 1000
	---help---
		Proportional gain for orientation PID controllers (value * 0.01).
		Controls bucket roll, pitch, and yaw response.

config BUCKET_TRAJECTORY_FOLLOWER_MAX_VELOCITY
	int "Maximum bucket velocity (m/s * 100)"
	default 200
	range 50 400
	---help---
		Maximum allowed bucket tip velocity in cm/s (value * 0.01 = m/s).
		Safety limit to prevent excessive bucket speeds.

config BUCKET_TRAJECTORY_FOLLOWER_MAX_FORCE
	int "Maximum bucket force (N)"
	default 5000
	range 1000 20000
	---help---
		Maximum allowed bucket force in Newtons.
		Safety limit to prevent damage to hydraulic system.

config BUCKET_TRAJECTORY_FOLLOWER_GRAVITY_COMPENSATION
	bool "Enable gravity compensation"
	default y
	---help---
		Enable gravity compensation for bucket weight.
		Improves positioning accuracy under varying loads.

config BUCKET_TRAJECTORY_FOLLOWER_LOAD_COMPENSATION
	bool "Enable load compensation"
	default y
	---help---
		Enable load compensation based on weight sensor readings.
		Adjusts control parameters based on bucket load.

config BUCKET_TRAJECTORY_FOLLOWER_JOINT_LIMITS
	bool "Enable joint limit checking"
	default y
	---help---
		Enable joint limit enforcement for boom and bucket actuators.
		Prevents mechanical damage from over-extension.

config BUCKET_TRAJECTORY_FOLLOWER_BOOM_EXT_MIN
	int "Minimum boom extension (mm)"
	default 500
	range 0 2000
	---help---
		Minimum boom extension in millimeters.
		Safety limit to prevent boom retraction beyond safe limits.

config BUCKET_TRAJECTORY_FOLLOWER_BOOM_EXT_MAX
	int "Maximum boom extension (mm)"
	default 3000
	range 2000 5000
	---help---
		Maximum boom extension in millimeters.
		Safety limit to prevent boom extension beyond safe limits.

config BUCKET_TRAJECTORY_FOLLOWER_BOOM_LIFT_MIN
	int "Minimum boom lift angle (degrees * 10)"
	default -300
	range -450 0
	---help---
		Minimum boom lift angle in tenths of degrees (value * 0.1 = degrees).
		Negative values indicate below horizontal.

config BUCKET_TRAJECTORY_FOLLOWER_BOOM_LIFT_MAX
	int "Maximum boom lift angle (degrees * 10)"
	default 600
	range 450 900
	---help---
		Maximum boom lift angle in tenths of degrees (value * 0.1 = degrees).
		Positive values indicate above horizontal.

config BUCKET_TRAJECTORY_FOLLOWER_BUCKET_TILT_MIN
	int "Minimum bucket tilt angle (degrees * 10)"
	default -900
	range -1800 0
	---help---
		Minimum bucket tilt angle in tenths of degrees (value * 0.1 = degrees).
		Negative values indicate bucket tilted back (dumping position).

config BUCKET_TRAJECTORY_FOLLOWER_BUCKET_TILT_MAX
	int "Maximum bucket tilt angle (degrees * 10)"
	default 450
	range 0 900
	---help---
		Maximum bucket tilt angle in tenths of degrees (value * 0.1 = degrees).
		Positive values indicate bucket tilted forward (digging position).

endif # MODULES_BUCKET_TRAJECTORY_FOLLOWER
```

## src/modules/wheel_loader_rc_input/Kconfig
```kconfig
menuconfig MODULES_WHEEL_LOADER_RC_INPUT
	bool "wheel_loader_rc_input"
	default n
	---help---
		Enable support for wheel loader RC input processing
```

## src/modules/wheel_loader_robot/Kconfig
```kconfig
menuconfig MODULES_WHEEL_LOADER_ROBOT
	bool "wheel_loader_robot"
	default n
	---help---
		Enable support for wheel loader robot module

if MODULES_WHEEL_LOADER_ROBOT

config MODULES_WHEEL_LOADER_ROBOT_DEBUG
	bool "Enable debug output"
	default n
	---help---
		Enable additional debug output for wheel loader robot

endif # MODULES_WHEEL_LOADER_ROBOT
```
