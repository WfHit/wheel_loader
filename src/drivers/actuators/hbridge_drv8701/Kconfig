## src/drivers/actuators/hbridge_drv8701/Kconfig
```kconfig
menuconfig DRIVERS_ACTUATORS_HBRIDGE_DRV8701
	bool "hbridge_drv8701"
	default n
	---help---
		Enable support for DRV8701 H-Bridge motor driver
```

## src/drivers/h_bridge/Kconfig
```kconfig
menuconfig DRIVERS_H_BRIDGE
	bool "h_bridge"
	default n
	---help---
		Enable support for DRV8701 H-Bridge motor driver
```

## src/drivers/hbridge/Kconfig
```kconfig
menuconfig DRIVERS_HBRIDGE
	bool "HBridge Driver"
	default n
	depends on BOARD_HAS_PWM
	help
	  Enable support for H-Bridge motor drivers with PWM speed control
	  and GPIO direction control. Supports multiple instances with
	  dual channels each.
```

## src/drivers/st3125_servo/Kconfig
```kconfig
menuconfig DRIVERS_ST3125_SERVO
	bool "ST3125 Smart Servo Driver"
	default n
	---help---
		Enable support for ST3125 smart servo motors.
		This driver provides control and feedback for SCServo ST3125
		smart servo motors via serial communication.

if DRIVERS_ST3125_SERVO

config ST3125_SERVO_MAX_SERVOS
	int "Maximum number of servos"
	default 12
	range 1 32
	---help---
		Maximum number of ST3125 servos that can be controlled
		simultaneously.

config ST3125_SERVO_SERIAL_DEVICE
	string "Serial device"
	default "/dev/ttyS3"
	---help---
		Serial device used for communication with ST3125 servos.

config ST3125_SERVO_DEFAULT_BAUDRATE
	int "Default baudrate"
	default 115200
	---help---
		Default baudrate for serial communication with ST3125 servos.
		Can be overridden by ST3125_BAUDRATE parameter.

config ST3125_SERVO_PROTOCOL_TIMEOUT
	int "Protocol timeout (ms)"
	default 10
	range 1 100
	---help---
		Timeout in milliseconds for servo communication protocol.

config ST3125_SERVO_MAX_RETRIES
	int "Maximum retries"
	default 3
	range 1 10
	---help---
		Maximum number of retries for failed servo communications.

config ST3125_SERVO_DEBUG
	bool "Enable debug output"
	default n
	---help---
		Enable debug output for ST3125 servo driver.

endif # DRIVERS_ST3125_SERVO
```

## src/drivers/st3215_servo/Kconfig
```kconfig
menuconfig DRIVERS_ST3215_SERVO
	bool "ST3215 servo driver"
	default n
	help
	  Enable support for ST3215 smart servo driver.

	  This driver provides communication with ST3215 smart servos
	  via UART interface, allowing position control and feedback.
```

## src/drivers/test_serial/Kconfig
```kconfig
menuconfig DRIVERS_TEST_SERIAL
	bool "Test Serial Driver"
	default n
	---help---
		Enable the Test Serial Driver for testing serial port communication.
		This driver provides comprehensive testing capabilities for serial ports
		including loopback tests, data integrity verification, and stress testing.
```

## src/drivers/uwb/Kconfig
```kconfig
menu "UWB"
    menuconfig COMMON_UWB
        bool "common UWB Drivers"
        default n
        select DRIVERS_UWB_UWB_SR150
        ---help---
            Enable support for uwb drivers

    config DRIVERS_UWB_NOOPLOOP_LINKTRACK
        bool "Nooploop LinkTrack UWB driver"
        default n
        ---help---
            Enable support for Nooploop LinkTrack UWB positioning system

    rsource "*/Kconfig"
endmenu
```

## src/drivers/uwb/nooploop_linktrack/Kconfig
```kconfig
menuconfig DRIVERS_UWB_NOOPLOOP_LINKTRACK
	bool "NoopLoop LinkTrack UWB driver"
	default n
	---help---
		Enable support for NoopLoop LinkTrack UWB positioning system.
		Simple driver for LP_MODE2 with Node_Frame3 protocol.
```

## src/examples/quad_encoder_test/Kconfig
```kconfig
menuconfig EXAMPLES_QUAD_ENCODER_TEST
	bool "Quadrature encoder test and examples"
	default n
	depends on DRIVERS_QUAD_ENCODER
	help
	  Test application for the quadrature encoder driver.
	  Includes basic encoder tests, motor control examples,
	  and linear position control demonstrations.
```

## src/modules/articulated_chassis/Kconfig
```kconfig
menuconfig MODULES_ARTICULATED_CHASSIS
	bool "articulated_chassis"
	default n
	help
		Enable support for articulated chassis control system for wheel loaders.
		This includes wheel control, steering, traction management, safety monitoring,
		and advanced terrain adaptation capabilities.

if MODULES_ARTICULATED_CHASSIS

config ARTICULATED_CHASSIS_WHEEL_CONTROLLER
	bool "Enable wheel controller"
	default y
	help
		Unified wheel controller for front and rear wheel velocity control
		with PID feedback and quad encoder integration.

config ARTICULATED_CHASSIS_STEERING_CONTROLLER
	bool "Enable steering controller"
	default y
	help
		Articulated chassis steering controller with PID position control
		and servo PWM output for hydraulic steering systems.

config ARTICULATED_CHASSIS_SLIP_ESTIMATOR
	bool "Enable slip estimator"
	default y
	help
		Advanced slip estimation using Extended Kalman Filter (EKF)
		for improved traction control performance.

config ARTICULATED_CHASSIS_PREDICTIVE_TRACTION
	bool "Enable predictive traction control"
	default y
	help
		Model Predictive Control (MPC) based traction management
		with slip prediction and terrain adaptation.

config ARTICULATED_CHASSIS_LOAD_AWARE_TORQUE
	bool "Enable load-aware torque distribution"
	default y
	help
		Dynamic torque distribution based on load sensing
		and weight distribution for optimal traction.

config ARTICULATED_CHASSIS_TERRAIN_ADAPTATION
	bool "Enable terrain adaptation"
	default y
	help
		Intelligent terrain classification and adaptation system
		for optimized performance across different surface types.

config ARTICULATED_CHASSIS_SAFETY_MANAGER
	bool "Enable safety manager"
	default y
	help
		Comprehensive safety monitoring system with emergency stop,
		watchdog timers, and fault detection capabilities.

config ARTICULATED_CHASSIS_CHASSIS_CONTROLLER
	bool "Enable main chassis controller"
	default y
	help
		Main coordinator module for the articulated chassis system.
		Integrates all subsystems and provides unified control interface.

endif # MODULES_ARTICULATED_CHASSIS
```

## src/modules/articulated_chassis/predictive_traction/Kconfig
```kconfig
menuconfig MODULES_PREDICTIVE_TRACTION
	bool "predictive_traction"
	default n
	---help---
		Enable support for predictive_traction
```

## src/modules/articulated_chassis/safety_manager/Kconfig
```kconfig
menuconfig MODULES_SAFETY_MANAGER
	bool "safety_manager"
	default n
	---help---
		Enable support for safety_manager
```

## src/modules/articulated_chassis/slip_estimator/Kconfig
```kconfig
menuconfig MODULES_SLIP_ESTIMATOR
	bool "slip_estimator"
	default n
	---help---
		Enable support for slip_estimator
```

## src/modules/articulated_chassis/steering_controller/Kconfig
```kconfig
menuconfig MODULES_STEERING_CONTROLLER
	bool "steering_controller"
	default n
	---help---
		Enable support for steering_controller
```

## src/modules/articulated_chassis/traction_control /load_aware_torque/Kconfig
```kconfig
menuconfig MODULES_LOAD_AWARE_TORQUE
	bool "load_aware_torque"
	default n
	---help---
		Enable support for load aware torque distribution
```

## src/modules/articulated_chassis/traction_control /terrain_adaptation/Kconfig
```kconfig
menuconfig MODULES_TERRAIN_ADAPTATION
	bool "terrain_adaptation"
	default n
	---help---
		Enable support for terrain_adaptation
```

## src/modules/articulated_chassis/traction_control/Kconfig
```kconfig
menuconfig MODULES_TRACTION_CONTROL
	bool "Traction Control"
	default n
	help
		Enable advanced traction control for articulated wheel loader
		with slip estimation and dynamic torque distribution for mining operations
```

## src/modules/articulated_chassis/wheel_controller/Kconfig
```kconfig
menuconfig ARTICULATED_CHASSIS_WHEEL_CONTROLLER
	bool "wheel controller"
	default n
	---help---
		Enable support for wheel controller module
```

## src/modules/boom_control/Kconfig
```kconfig
menuconfig MODULES_BOOM_CONTROL
	bool "boom_control"
	default n
	---help---
		Enable support for Boom Control module.

		This module controls the boom actuator for wheel loader vehicles,
		providing position control using DRV8701 H-bridge motor driver
		and AS5600 magnetic encoder for angle feedback.

menuconfig USER_BOOM_CONTROL
	bool "boom_control running as userspace module"
	default n
	depends on BOARD_PROTECTED && MODULES_BOOM_CONTROL
	---help---
		Put boom_control in userspace memory
```

## src/modules/bucket_control/Kconfig
```kconfig
menuconfig MODULES_BUCKET_CONTROL
	bool "bucket_control"
	default n
	---help---
		Enable support for bucket control module

		This module provides advanced bucket control for wheel loader applications
		including kinematic calculations, motion planning, boom compensation,
		and state management with calibration.

if MODULES_BUCKET_CONTROL

config BUCKET_CONTROL_BOOM_COMPENSATION
	bool "Enable boom compensation"
	default y
	---help---
		Enable boom angle compensation to maintain bucket orientation
		relative to ground when boom moves.

config BUCKET_CONTROL_CALIBRATION
	bool "Enable automatic calibration"
	default y
	---help---
		Enable automatic calibration sequence to determine actuator
		limits and bucket angle ranges.

config BUCKET_CONTROL_PERFORMANCE_MONITORING
	bool "Enable performance monitoring"
	default y
	---help---
		Enable performance metrics collection for control system
		analysis and tuning.

endif # MODULES_BUCKET_CONTROL
```

## src/modules/operation_mode_manager/Kconfig
```kconfig
menuconfig MODULES_OPERATION_MODE_MANAGER
	bool "operation_mode_manager"
	default n
	---help---
		Enable support for Operation Mode Manager module.

		This module manages operation modes for wheel loader robots:
		- Manual mode: Direct RC control of chassis and bucket
		- VLA mode: Vision-Language-Action autonomous trajectory following

		The module handles mode switching, trajectory decomposition,
		safety monitoring, and coordinated motion control.

if MODULES_OPERATION_MODE_MANAGER

config MODULES_OPERATION_MODE_MANAGER_MANUAL_MODE
	bool "Enable Manual Mode"
	default y
	---help---
		Enable manual operation mode with RC input processing
		and trajectory generation for chassis and bucket control.

config MODULES_OPERATION_MODE_MANAGER_VLA_MODE
	bool "Enable VLA Mode"
	default y
	---help---
		Enable Vision-Language-Action autonomous mode with
		trajectory decomposition and coordinated motion control.

config MODULES_OPERATION_MODE_MANAGER_CHASSIS_MPC
	bool "Enable Chassis MPC Controller"
	default y
	---help---
		Enable Model Predictive Control for chassis trajectory
		following with TinyMPC implementation.

config MODULES_OPERATION_MODE_MANAGER_BUCKET_PID
	bool "Enable Bucket PID Controller"
	default y
	---help---
		Enable 6-DOF PID control for bucket trajectory following
		with gravity and load compensation.

config MODULES_OPERATION_MODE_MANAGER_SAFETY
	bool "Enable Safety Features"
	default y
	---help---
		Enable safety monitoring, emergency stop functionality,
		and mode switching safety checks.

config MODULES_OPERATION_MODE_MANAGER_COORDINATION
	bool "Enable Chassis-Bucket Coordination"
	default y
	---help---
		Enable coordination between chassis and bucket motion
		for improved reach and stability.

endif # MODULES_OPERATION_MODE_MANAGER
```

## src/modules/trajectory_followers/Kconfig
```kconfig
menuconfig MODULES_TRAJECTORY_FOLLOWERS
	bool "trajectory_followers"
	default n
	---help---
		Enable support for trajectory following modules

if MODULES_TRAJECTORY_FOLLOWERS

config MODULES_CHASSIS_TRAJECTORY_FOLLOWER
	bool "chassis_trajectory_follower"
	default y
	depends on MODULES_TRAJECTORY_FOLLOWERS
	---help---
		Enable the chassis trajectory follower module.
		This module implements Model Predictive Control (MPC) for chassis motion,
		providing trajectory following capabilities for the wheel loader chassis.

config MODULES_BUCKET_TRAJECTORY_FOLLOWER
	bool "bucket_trajectory_follower"
	default y
	depends on MODULES_TRAJECTORY_FOLLOWERS
	---help---
		Enable the bucket trajectory follower module.
		This module implements 6-DOF PID control for bucket motion,
		providing trajectory following capabilities for the wheel loader bucket assembly.

endif # MODULES_TRAJECTORY_FOLLOWERS
```

## src/modules/trajectory_followers/chassis_trajectory_follower/Kconfig
```kconfig
menuconfig MODULES_CHASSIS_TRAJECTORY_FOLLOWER
	bool "chassis_trajectory_follower"
	default y
	depends on MODULES_TRAJECTORY_FOLLOWERS
	---help---
		Enable the chassis trajectory follower module.

		This module implements Model Predictive Control (MPC) for chassis motion control.
		It provides trajectory following capabilities for the wheel loader chassis,
		including:
		- MPC-based trajectory tracking
		- Velocity and acceleration constraints
		- Emergency stop handling
		- Coordination with bucket controller
		- Real-time trajectory optimization

if MODULES_CHASSIS_TRAJECTORY_FOLLOWER

config CHASSIS_TRAJECTORY_FOLLOWER_MPC_PREDICTION_HORIZON
	int "MPC prediction horizon steps"
	default 10
	range 5 20
	---help---
		Number of prediction steps in the MPC horizon.
		Higher values provide better trajectory tracking but increase computational cost.

config CHASSIS_TRAJECTORY_FOLLOWER_MPC_CONTROL_HORIZON
	int "MPC control horizon steps"
	default 5
	range 3 10
	---help---
		Number of control steps in the MPC horizon.
		Must be less than or equal to prediction horizon.

config CHASSIS_TRAJECTORY_FOLLOWER_UPDATE_RATE
	int "Controller update rate (Hz)"
	default 50
	range 20 100
	---help---
		Update frequency of the chassis trajectory follower in Hz.
		Higher rates provide better tracking but increase CPU usage.

config CHASSIS_TRAJECTORY_FOLLOWER_MAX_VELOCITY
	int "Maximum chassis velocity (m/s * 100)"
	default 300
	range 50 500
	---help---
		Maximum allowed chassis velocity in cm/s (value * 0.01 = m/s).
		Safety limit to prevent excessive speeds.

config CHASSIS_TRAJECTORY_FOLLOWER_MAX_ACCELERATION
	int "Maximum chassis acceleration (m/s² * 100)"
	default 200
	range 50 400
	---help---
		Maximum allowed chassis acceleration in cm/s² (value * 0.01 = m/s²).
		Safety limit to prevent excessive accelerations.

config CHASSIS_TRAJECTORY_FOLLOWER_EMERGENCY_STOP_DECEL
	int "Emergency stop deceleration (m/s² * 100)"
	default 500
	range 200 1000
	---help---
		Emergency stop deceleration in cm/s² (value * 0.01 = m/s²).
		Higher values provide faster stopping but may cause instability.

endif # MODULES_CHASSIS_TRAJECTORY_FOLLOWER
```
