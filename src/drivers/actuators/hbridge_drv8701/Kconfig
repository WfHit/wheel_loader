## src/modules/trajectory_followers/end_effector_trajectory_follower/Kconfig
```kconfig
menuconfig MODULES_END_EFFECTOR_TRAJECTORY_FOLLOWER
	bool "end_effector_trajectory_follower"
	default y
	depends on MODULES_TRAJECTORY_FOLLOWERS
	---help---
		Enable the end effector trajectory follower module.

		This module implements 6-DOF PID control for end effector motion control.
		It provides trajectory following capabilities for the wheel loader end effector assembly,
		including:
		- 6-DOF PID controllers (position + orientation)
		- Joint limit enforcement
		- Gravity compensation
		- Load handling compensation
		- Safety constraint monitoring

if MODULES_END_EFFECTOR_TRAJECTORY_FOLLOWER

config END_EFFECTOR_TRAJECTORY_FOLLOWER_UPDATE_RATE
	int "Controller update rate (Hz)"
	default 50
	range 20 100
	---help---
		Update frequency of the end effector trajectory follower in Hz.
		Higher rates provide better tracking but increase CPU usage.

config END_EFFECTOR_TRAJECTORY_FOLLOWER_PID_P_GAIN
	int "Position PID proportional gain (* 100)"
	default 500
	range 100 2000
	---help---
		Proportional gain for position PID controllers (value * 0.01).
		Higher values provide faster response but may cause oscillations.

config END_EFFECTOR_TRAJECTORY_FOLLOWER_PID_I_GAIN
	int "Position PID integral gain (* 1000)"
	default 100
	range 0 500
	---help---
		Integral gain for position PID controllers (value * 0.001).
		Helps eliminate steady-state errors.

config END_EFFECTOR_TRAJECTORY_FOLLOWER_PID_D_GAIN
	int "Position PID derivative gain (* 1000)"
	default 50
	range 0 200
	---help---
		Derivative gain for position PID controllers (value * 0.001).
		Provides damping and improves stability.

config END_EFFECTOR_TRAJECTORY_FOLLOWER_ORIENTATION_P_GAIN
	int "Orientation PID proportional gain (* 100)"
	default 300
	range 50 1000
	---help---
		Proportional gain for orientation PID controllers (value * 0.01).
		Controls end effector roll, pitch, and yaw response.

config END_EFFECTOR_TRAJECTORY_FOLLOWER_MAX_VELOCITY
	int "Maximum end effector velocity (m/s * 100)"
	default 200
	range 50 400
	---help---
		Maximum allowed end effector tip velocity in cm/s (value * 0.01 = m/s).
		Safety limit to prevent excessive end effector speeds.

config END_EFFECTOR_TRAJECTORY_FOLLOWER_MAX_FORCE
	int "Maximum end effector force (N)"
	default 5000
	range 1000 20000
	---help---
		Maximum allowed end effector force in Newtons.
		Safety limit to prevent damage to hydraulic system.

config END_EFFECTOR_TRAJECTORY_FOLLOWER_GRAVITY_COMPENSATION
	bool "Enable gravity compensation"
	default y
	---help---
		Enable gravity compensation for end effector weight.
		Improves positioning accuracy under varying loads.

config END_EFFECTOR_TRAJECTORY_FOLLOWER_LOAD_COMPENSATION
	bool "Enable load compensation"
	default y
	---help---
		Enable load compensation based on weight sensor readings.
		Adjusts control parameters based on end effector load.

config END_EFFECTOR_TRAJECTORY_FOLLOWER_JOINT_LIMITS
	bool "Enable joint limit checking"
	default y
	---help---
		Enable joint limit enforcement for boom and end effector actuators.
		Prevents mechanical damage from over-extension.

config BUCKET_TRAJECTORY_FOLLOWER_BOOM_EXT_MIN
	int "Minimum boom extension (mm)"
	default 500
	range 0 2000
	---help---
		Minimum boom extension in millimeters.
		Safety limit to prevent boom retraction beyond safe limits.

config BUCKET_TRAJECTORY_FOLLOWER_BOOM_EXT_MAX
	int "Maximum boom extension (mm)"
	default 3000
	range 2000 5000
	---help---
		Maximum boom extension in millimeters.
		Safety limit to prevent boom extension beyond safe limits.

config BUCKET_TRAJECTORY_FOLLOWER_BOOM_LIFT_MIN
	int "Minimum boom lift angle (degrees * 10)"
	default -300
	range -450 0
	---help---
		Minimum boom lift angle in tenths of degrees (value * 0.1 = degrees).
		Negative values indicate below horizontal.

config BUCKET_TRAJECTORY_FOLLOWER_BOOM_LIFT_MAX
	int "Maximum boom lift angle (degrees * 10)"
	default 600
	range 450 900
	---help---
		Maximum boom lift angle in tenths of degrees (value * 0.1 = degrees).
		Positive values indicate above horizontal.

config END_EFFECTOR_TRAJECTORY_FOLLOWER_END_EFFECTOR_TILT_MIN
	int "Minimum end effector tilt angle (degrees * 10)"
	default -900
	range -1800 0
	---help---
		Minimum end effector tilt angle in tenths of degrees (value * 0.1 = degrees).
		Negative values indicate end effector tilted back (dumping position).

config END_EFFECTOR_TRAJECTORY_FOLLOWER_END_EFFECTOR_TILT_MAX
	int "Maximum end effector tilt angle (degrees * 10)"
	default 450
	range 0 900
	---help---
		Maximum end effector tilt angle in tenths of degrees (value * 0.1 = degrees).
		Positive values indicate end effector tilted forward (digging position).

endif # MODULES_END_EFFECTOR_TRAJECTORY_FOLLOWER
```

## src/modules/vla_proxy/Kconfig
```kconfig
menuconfig MODULES_VLA_PROXY
	bool "vla_proxy"
	default n
	---help---
		Enable support for VLA (Vision-Language-Action) proxy module.
		This module acts as a bridge between PX4 and VLA models,
		enabling autonomous control through natural language commands
		and visual understanding.

menuconfig USER_VLA_PROXY
	bool "vla_proxy running as userspace module"
	default y
	depends on BOARD_PROTECTED && MODULES_VLA_PROXY
	---help---
		Put vla_proxy in userspace memory
```
